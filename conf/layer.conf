## conf/layer.conf
```bitbake
# We might have a conf and classes directory, append to BBPATH
BBPATH .= ":${LAYERDIR}"

# We have a recipes directory, add to BBFILES
BBFILES += "${LAYERDIR}/recipes*/*/*.bb ${LAYERDIR}/recipes-*/*/*.bbappend"

BBFILE_COLLECTIONS += "meta-mbed-cloud-client"
BBFILE_PATTERN_meta-mbed-cloud-client = "^${LAYERDIR}/"
BBFILE_PRIORITY_meta-mbed-cloud-client = "6"

LAYERSERIES_COMPAT_meta-mbed-cloud-client = "zeus"
```
